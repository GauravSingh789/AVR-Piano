/* Author Name: Kumar Gaurav singh
   Roll Number: 108118058 
   Domain: Embedded and Analog Electronics
   Sub-Domain: Embedded Systems
   Functions : timer2_init, main
   Global Variables: i, Pwm_Comapre_Value[] */


#include <avr/io.h> /* Include AVR Std header file */
#include <avr/interrupt.h> /* Include Std interrupt header file*/

// clock frequency --->16MHz
uint8_t i=0;

 //Defining 256 sinusoidally varying values for OCR0A register to Obtain different duty cycles:
uint8_t Pwm_Compare_Value[]= {
0x80,0x83,0x86,0x89,0x8c,0x8f,0x92,0x95,0x98,0x9c,0x9f,0xa2,0xa5,0xa8,0xab,0xae,
0xb0,0xb3,0xb6,0xb9,0xbc,0xbf,0xc1,0xc4,0xc7,0xc9,0xcc,0xce,0xd1,0xd3,0xd5,0xd8,
0xda,0xdc,0xde,0xe0,0xe2,0xe4,0xe6,0xe8,0xea,0xec,0xed,0xef,0xf0,0xf2,0xf3,0xf5,
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0x4f,0x51,0x54,0x57,0x5a,0x5d,0x60,0x63,0x67,0x6a,0x6d,0x70,0x73,0x76,0x79,0x7c
};                                                                                   

/* Function Name: timer2_init
   Logic: Setting up TIMER 2 in CTC mode, with no prescaling and enabling interrupt on compare match
   Example Call: timer2_init(); */
void timer2_init()
{
  TCCR2A= (1<<WGM21);//Timer 2 in CTC Mode
  TCCR2B= (1<<CS20); // No prescaling
  TCNT2=0;
  TIMSK2= (1<<OCIE2A); //Enabling interrupt on compare match
  sei(); //Enabling global interrupt
}

ISR(TIMER2_COMPA_vect)
 { 
  OCR0A = Pwm_Compare_Value[i];
  i++;
 }
   /*-----------------------------------------------------------------------------------------------------------------------------------------------------------------------*/
int main(void)
{
  DDRC=0x00; //making port C as INPUT pin
  DDRD=(1<<6); //making PD6(OC0A) as OUTPUT pin

    //Setting up TIMER0 in Fast PWM Mode 
   TCCR0A =(1<<WGM00)|(1<<WGM01)|(1<<COM0A1);  //Non-Inverting mode
   TCCR0B= (1<<CS00); //No prescaling
   TCNT0=0;
   timer2_init();
   
 
while(1)
 { 
  // To calculate Sampling time(time interval between firing of two consecutive interrupts) for notes of different frequencies:
  
  // Let note frequency of musical note be f. Time period=1/f
  // 1/f= 256*(Sampling time) { as, 256 interrupts are fired assigning one of the 256 different sinusoidally varying values to OCR0A register}
  
  // (1/(clock freqency))*(OCR2A+1) = Sampling time. {Since,prescaler=1, (Clock frequency)= 16MHz}
  // Thus,OCR2A = ((Clock frequency)*(Sampling time))-1 = ((Clock frequency)/(256*f))-1
  // Thus, OCR2A value to be assigned while generating each musical note is calculated. 

  //Push Button Interfacing done in Pull-up mode

  if(!(PINC & (1<<PC0))) //When Button is pressed
 {
  OCR2A= 237; // For note C4---> f= 262Hz  
 }
 
 else if(!(PINC & (1<<PC1))) //When Button is pressed
 {
  OCR2A= 211; // For note D4--->f= 294Hz
 }
 else if(!(PINC & (1<<PC2))) //When Button is pressed
 {
  OCR2A= 190; // For note E4---> f= 327Hz
 }
 else if(!(PINC & (1<<PC3)))//When Button is pressed
 {
  OCR2A= 178; // For note F4---> f=349Hz
  }
 else if(!(PINC & (1<<PC4)))//When Button is pressed
 {
  OCR2A= 141; // For note A4---> f= 440Hz
 }
  else if(!(PINC & (1<<PC5)))//When Button is pressed
  {
  OCR2A= 125; // For note B4---> f= 494Hz
  }
 else{
  TCNT0=0;
  TCNT2=0;
   }
 }
}
